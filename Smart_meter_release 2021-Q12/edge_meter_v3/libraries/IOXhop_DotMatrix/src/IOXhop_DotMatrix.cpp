#include "IOXhop_DotMatrix.h"

// Font code from https://gitlab.com/kidbright/kidbright32/-/blob/master/kidbright32/src/ht16k33.cpp
const unsigned char font_6_8[] = {
  0x00, 0x00, 0x00, 0x00, 0x00, 0x00,  // 0x00
  0x00, 0x7c, 0xa2, 0x8a, 0xa2, 0x7c,  // 0x01
  0x00, 0x7c, 0xd6, 0xf6, 0xd6, 0x7c,  // 0x02
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  0x00, 0x00, 0x00, 0x00, 0x00, 0x00  // 0xff
};

#define CMD_NOOP 0
#define CMD_DIGIT0 1
#define CMD_DECODEMODE 9
#define CMD_INTENSITY 10
#define CMD_SCANLIMIT 11
#define CMD_SHUTDOWN 12
#define CMD_DISPLAYTEST 15

#define SPI_SETTING SPISettings(8000000, MSBFIRST, SPI_MODE0)

#if defined(ARDUINO_ARCH_ESP32) || defined(ARDUINO_ARCH_ESP8266)
IOXhop_DotMatrix::IOXhop_DotMatrix(int max_device, int cs, int dio, int clk) {
#else
IOXhop_DotMatrix::IOXhop_DotMatrix(int max_device, int cs) {
#endif
    _cs_pin = cs;
#if defined(ARDUINO_ARCH_ESP32) || defined(ARDUINO_ARCH_ESP8266)
    _dio_pin = dio;
    _clk_pin = clk;
#endif
    display_number = max_device;
}

void IOXhop_DotMatrix::begin() {
#if defined(ARDUINO_ARCH_ESP32) || defined(ARDUINO_ARCH_ESP8266)
    SPI.begin(_clk_pin, -1, _dio_pin, -1); // CLK, MISO, MOSI, SS
#else
    SPI.begin();
#endif
    pinMode(5, OUTPUT);
    digitalWrite(_cs_pin, 1);

    shutdown(true);

    _write(CMD_DISPLAYTEST, 0);
    _write(CMD_SCANLIMIT, 7);
    _write(CMD_DECODEMODE, 0);

    shutdown(false);
    intensity(10);

    bufferDisplay = (uint8_t*)malloc(8 * display_number);
    memset(bufferDisplay, 0, 8 * display_number);
}

void IOXhop_DotMatrix::shutdown(bool value) {
    _write(CMD_SHUTDOWN, value ? 0 : 1);
}

void IOXhop_DotMatrix::intensity(int level) {
    level = constrain(level, 0, 15);
    _write(CMD_INTENSITY, level);
}

void IOXhop_DotMatrix::_write(uint8_t cmd, uint8_t data) {
    digitalWrite(_cs_pin, 0);
    SPI.beginTransaction(SPI_SETTING);
    for (uint8_t i = 0; i < display_number; i++) {
        SPI.transfer(cmd);
        SPI.transfer(data);
    }
    SPI.endTransaction();
    digitalWrite(_cs_pin, 1);
}

void IOXhop_DotMatrix::show() {
    uint8_t* writeData = (uint8_t*)malloc(8 * display_number);
    memset(writeData, 0, 8 * display_number);

    // Flip Buffer
    for (uint8_t seg = 0; seg < display_number; seg++) {
        for (uint8_t y = 0; y < 8; y++) {
            for (uint8_t x = 0; x < 8; x++) {
                writeData[(seg * 8) + y] |= ((bufferDisplay[(seg * 8) + (7 - x)] & (1 << (7 - y))) != 0 ? 1 : 0) << x;
            }
        }
    }

    for (uint8_t row = 0; row < 8; row++) {
        digitalWrite(_cs_pin, 0);
        SPI.beginTransaction(SPI_SETTING);
        for (uint8_t i = 0; i < display_number; i++) {
            SPI.transfer(CMD_DIGIT0 + row);
            SPI.transfer(writeData[(i * 8) + row]);
        }
        SPI.endTransaction();
        digitalWrite(_cs_pin, 1);
    }
}

void IOXhop_DotMatrix::clear() {
    memset(bufferDisplay, 0, 8 * display_number);
    show();
}

int IOXhop_DotMatrix::calcTextWidth(String text) {
    return text.length() * 6;
}

void IOXhop_DotMatrix::invertColor(bool showOnDisplay) {
    for (int i=0;i<display_number * 8;i++) {
        bufferDisplay[i] = ~bufferDisplay[i];
    }
    if (showOnDisplay) show();
}

void IOXhop_DotMatrix::showText(String text, int top, int left, bool invert) {
    int textWidth = text.length() * 6;
    uint8_t *bufferText = (uint8_t*)malloc(textWidth);
    for (uint8_t i = 0; i < text.length(); i++) {
        memcpy(&bufferText[i * 6], &font_6_8[text.charAt(i) * 6], 6);
    }

    if (top > 0) {
        for (uint8_t i = 0; i < textWidth;i++) {
            bufferText[i] >>= top;
        }
    } else if (top < 0) {
        for (uint8_t i = 0; i < textWidth;i++) {
            bufferText[i] <<= -top;
        }
    }

    int displayWidth = display_number * 8;
    memset(bufferDisplay, 0, 8 * display_number);
    if (left < displayWidth) {
        if (left >= 0) {
            memcpy(&bufferDisplay[left], bufferText, min(textWidth, displayWidth - left));
        } else {
            memcpy(&bufferDisplay[0], &bufferText[-left], min(textWidth + left, displayWidth));
        }
    }
    if (invert) {
        invertColor(false);
    }
    show();
    free(bufferText);
}

void IOXhop_DotMatrix::showTextCenter(String text) {
    int textWidth = calcTextWidth(text);
    showText(text, 0, ((display_number * 8 / 2) - (textWidth / 2)) - 1);
}

void IOXhop_DotMatrix::scrollInLeft(String text, int speed) {
    int textWidth = calcTextWidth(text);
    for (int left=-textWidth;left<=(((display_number * 8 / 2) - (textWidth / 2)) - 1);left++) {
        showText(text, 0, left);
        delay(speed);
    }
}

void IOXhop_DotMatrix::scrollOutLeft(String text, int speed) {
    int textWidth = calcTextWidth(text);
    for (int left=(((display_number * 8 / 2) - (textWidth / 2)) - 1);left>=-calcTextWidth(text);left--) {
        showText(text, 0, left);
        delay(speed);
    }
}

void IOXhop_DotMatrix::scrollInRight(String text, int speed) {
    int textWidth = calcTextWidth(text);
    for (int left=8*8;left>=(((display_number * 8 / 2) - (textWidth / 2)) - 1);left--) {
        showText(text, 0, left);
        delay(speed);
    }
}

void IOXhop_DotMatrix::scrollOutRight(String text, int speed) {
    int textWidth = calcTextWidth(text);
    for (int left=(((display_number * 8 / 2) - (textWidth / 2)) - 1);left<=8*8;left++) {
        showText(text, 0, left);
        delay(speed);
    }
}

void IOXhop_DotMatrix::scrollInTop(String text, int speed) {
    int textWidth = calcTextWidth(text);
    for (int top=-8;top<=0;top++) {
        showText(text, top, (((display_number * 8 / 2) - (textWidth / 2)) - 1));
        delay(speed);
    }
}

void IOXhop_DotMatrix::scrollOutTop(String text, int speed) {
    int textWidth = calcTextWidth(text);
    for (int top=0;top>=-8;top--) {
        showText(text, top, (((display_number * 8 / 2) - (textWidth / 2)) - 1));
        delay(speed);
    }
}

void IOXhop_DotMatrix::scrollInBottom(String text, int speed) {
    int textWidth = calcTextWidth(text);
    for (int top=8;top>=0;top--) {
        showText(text, top, (((display_number * 8 / 2) - (textWidth / 2)) - 1));
        delay(speed);
    }
}

void IOXhop_DotMatrix::scrollOutBottom(String text, int speed) {
    int textWidth = calcTextWidth(text);
    for (int top=0;top<=8;top++) {
        showText(text, top, (((display_number * 8 / 2) - (textWidth / 2)) - 1));
        delay(speed);
    }
}

void IOXhop_DotMatrix::scrollLeftToRight(String text, int speed, int pause) {
    scrollInLeft(text, speed);
    delay(pause);
    scrollOutRight(text, speed);
}

void IOXhop_DotMatrix::scrollRightToLeft(String text, int speed, int pause) {
    scrollInRight(text, speed);
    delay(pause);
    scrollOutLeft(text, speed);
}
